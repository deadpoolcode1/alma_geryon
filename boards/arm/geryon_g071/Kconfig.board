## boards/arm/geryon_g071/Kconfig.board
```kconfig
config BOARD_GERYON_G071
	bool "Development Board for Geryon with G071 hardware"
	depends on SOC_STM32G071XX
```

## boards/arm/geryon_g071/Kconfig.defconfig
```kconfig
if BOARD_GERYON_G071

config BOARD
	default "geryon_g071"

endif # BOARD_GERYON_G071
```
